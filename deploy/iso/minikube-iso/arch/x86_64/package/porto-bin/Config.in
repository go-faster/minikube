## deploy/iso/minikube-iso/arch/x86_64/package/porto-bin/Config.in
```kconfig
config BR2_PACKAGE_PORTO_BIN
	bool "porto-bin"
	default y
	depends on BR2_x86_64
```

## deploy/iso/minikube-iso/arch/x86_64/package/portoshim-bin/Config.in
```kconfig
config BR2_PACKAGE_PORTOSHIM_BIN
	bool "portoshim-bin"
	default y
	depends on BR2_x86_64
```
